#include <U8g2lib.h>
#include "Animation.h"
#include "Distracter.h"
#include <EEPROM.h>
#define WiFi_Logo_width 60
#define WiFi_Logo_height 36



const uint8_t background[] PROGMEM = {
  0x00, 0x00, 0x00, 0x00, 0x00, 0x00, 0x00, 0x00, 0x00, 0x00, 0x00, 0x00, 
  0x00, 0x00, 0x00, 0x00, 0x00, 0x00, 0x00, 0x00, 0x00, 0x00, 0x00, 0x00, 
  0x00, 0x00, 0x00, 0x00, 0x00, 0x00, 0x00, 0x00, 0x00, 0x00, 0x00, 0x00, 
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  0xFF, 0xFF, 0xFF, 0xFF, };


const uint8_t bird[] PROGMEM = {
  0xE0, 0x07, 0xAE, 0x08, 0x91, 0x0A, 0x91, 0x08, 0x21, 0x0F, 0x3E, 0x3C, 
  0x04, 0x3C, 0x08, 0x02, 0xF0, 0x01, };

static const unsigned char happyFace[] U8X8_PROGMEM = {0x00,0x00,0x00,0x00,0x3c,0x00,0x80,0x07,0x5e,0x00,0xc0,0x0b,0x7e,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0x00,0x00};
static const unsigned char lskTrademark[] U8X8_PROGMEM = {0x00,0x00,0x00,0x00,0x00,0xe0,0x3f,0x00,0x00,0x00,0x00,0x00,0x00,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0x00,0x00};


#define MAIN_MENU_SCREEN 0
#define GAMEPLAY_SCREEN 1
#define GAMEOVER_SCREEN 2

#define BIRD_WIDTH 14
#define BIRD_HEIGHT 9

// Initialize the U8g2 library for SH1106 (assuming the same I2C pins D1 and D2)
U8G2_SSD1306_128X64_NONAME_F_HW_I2C display(U8G2_R0, U8X8_PIN_NONE);

float wall[4];
int empty[4];
int space = 32;
int widthOfPassage = 30;

int gameState = MAIN_MENU_SCREEN;

const int TOUCH_SENSOR_PIN = 2;
int buttonState = 0;

int score = 0;
int isJumping = 0;
int currentTime = 0;
int direction = 1;
int play = 0;

float birdX = 5.00;
float birdY = 22.00;

unsigned long ton = 0;

Animation animation;
Distracter distracter;


bool isDistractionIsForced = false;
bool isDonWant = false;
bool isAlreadyInDistraction = false;


bool isWantToPlaygame = true;

void setup() {
  Serial.begin(9600);
  display.begin();
  pinMode(TOUCH_SENSOR_PIN, INPUT);
  generateWalls();

  bool storedBool = EEPROM.read(0);

  if (storedBool == false) {
    isWantToPlaygame = false;
    EEPROM.write(0, true);
  } else {
    isWantToPlaygame = true;
    EEPROM.write(0, false);
  }

  // digitalWrite(TOUCH_SENSOR_PIN, LOW);
}

void loop() {
  display.clearBuffer();  // Clear display buffer
  
  buttonState = digitalRead(TOUCH_SENSOR_PIN);
  
  if (isWantToPlaygame) {
    flappyFlappy();
    EEPROM.write(0, false);
  } else {
    displayGreetings(buttonState == HIGH ? true : false);
    EEPROM.write(0, true);
  }

  if (animation.isHalfAnimationCompeleted()) {
    isWantToPlaygame = true;
  }

  if (!animation._isAnimationIsCompelete()) {
    animation.display(display);
    animation.update();
  }

  display.sendBuffer();  // Send the display buffer to the screen
}

void displayGreetings(int isColorInverted) {
  display.setFontMode(1);

  if (!isColorInverted) {
    isDistractionIsForced = false;
    isDonWant = true;
    isAlreadyInDistraction = false;
    animation.stopAnimation();
    animation.reset();
  } else {
    isDistractionIsForced = true;
    
    isDonWant = false;
    if (!isAlreadyInDistraction) {
      animation.startAnimation();
    }

    isAlreadyInDistraction = true;
  }

  distracter.display(display);
  distracter.update(isDistractionIsForced);

  animation.display(display);
  animation.update();



  display.setBitmapMode(1);
  display.drawXBMP(95, 46, 29, 14, happyFace);
  display.drawXBMP(28, 2, 71, 61, lskTrademark);
}

void flappyFlappy() {
  if (gameState == MAIN_MENU_SCREEN) {
    // Serial.println("MAIN_MENU_SCREEN");
    showMainMenuScreen();
  } else if (gameState == GAMEPLAY_SCREEN) {
    showGamePlayScreen();
    // Serial.println("GAMEPLAY_SCREEN");
  } else if (gameState == GAMEOVER_SCREEN) {
    showGameOverScreen();
    // Serial.println("GAMEOVER_SCREEN");
  }
}

void showMainMenuScreen() {
  display.setFont(u8g2_font_helvR10_tf);  // Use a U8g2 font
  // display.drawStr(0, 16, "Flappy ");
  display.drawXBMP(0, 0, 128, 64, background);  // Draw the background XBM
  drawBird(20, 15);

  display.setFont(u8g2_font_helvR08_tf);  // Smaller font for instructions
  display.drawStr(0, 44, "Press to start");

  if (buttonState == HIGH && animation._isAnimationIsCompelete()) {
    gameState = GAMEPLAY_SCREEN;
  }
}

void showGamePlayScreen() {
  int val = 10;

  display.setFont(u8g2_font_helvR08_tf);
  // display.drawStr(3, 10, String(score).c_str());
  display.setCursor(3, 10);
  display.println(score);

  if (buttonState == HIGH) {
    if (isJumping == 0) {
      currentTime = millis();
      ton = millis();
      direction = 1;
      play = 1;
      isJumping = 1;
    }
  } else {
    isJumping = 0;
  }

  for (int i = 0; i < 4; i++) {
    // Draw the wall
    display.drawBox(wall[i], 0, 6, 64);
    display.setDrawColor(0);  // Set draw color to black to draw the empty passage
    display.drawBox(wall[i], empty[i], 6, widthOfPassage);
    display.setDrawColor(1);  // Reset draw color to white

    // Move the wall and check if need to move the position of the wall
    wall[i] -= 1;

    if (wall[i] < 0) {
      score = score + 1;
      empty[i] = random(8, 32);
      wall[i] = 128 + 5;
    }

    // Check for collision
    if (wall[i] <= birdX + 7 && birdX + 7 <= wall[i] + 6) {
      if (birdY < empty[i] || birdY + BIRD_HEIGHT > empty[i] + widthOfPassage) {
        gameOver();
      }
    }
  }

  drawBird(birdX, birdY);

  if ((currentTime + 185) < millis()) {
    direction = 0;
  }

  if ((ton + 40) < millis()) {
    play = 0;
  }

  if (direction == 0) {
    birdY += 1;
  } else {
    birdY -= 2;
  }

  if (birdY >= 64 || birdY < -3) {  // Check if the bird collided with the upper or lower bounds
    gameOver();
  }

  display.drawFrame(0, 0, 128, 64);
}

void showGameOverScreen() {
  display.setFont(u8g2_font_helvR10_tf);
  display.drawStr(0, 16, "Score: ");
  display.drawXBMP(0, 0, 128, 64, background);
  display.setCursor(20, 35);
  display.println(score);

  display.setFont(u8g2_font_helvR08_tf);
  display.drawStr(0, 44, "Press to start");

  if (buttonState == HIGH) {
    score = 0;
    gameState = GAMEPLAY_SCREEN;
    buttonState = LOW;
  }
}

void drawBird(int x, int y) {
  display.drawXBMP(x, y, BIRD_WIDTH, BIRD_HEIGHT, bird);  // Draw the bird XBM
}

void gameOver() {
  gameState = GAMEOVER_SCREEN;
  birdY = 22;
  delay(500);
  generateWalls();
}

void generateWalls() {
  for (int i = 0; i < 4; i++) {
    wall[i] = 128 + ((i + 1) * space);
    empty[i] = random(8, 32);
  }
}
